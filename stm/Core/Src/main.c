/* USER CODE BEGIN Header */
/**
  ******************************************************************************
  * @file           : main.c
  * @brief          : Main program body
  ******************************************************************************
  * @attention
  *
  * Copyright (c) 2025 STMicroelectronics.
  * All rights reserved.
  *
  * This software is licensed under terms that can be found in the LICENSE file
  * in the root directory of this software component.
  * If no LICENSE file comes with this software, it is provided AS-IS.
  *
  ******************************************************************************
  */
/* USER CODE END Header */
/* Includes ------------------------------------------------------------------*/
#include "main.h"
#include "usart.h"
#include "gpio.h"

/* Private includes ----------------------------------------------------------*/
/* USER CODE BEGIN Includes */
#include "mpu_6050.h"
#include "math.h"
#include "kalman_filter.h"
#include "pid.h"
/* USER CODE END Includes */

/* Private typedef -----------------------------------------------------------*/
/* USER CODE BEGIN PTD */

/* USER CODE END PTD */

/* Private define ------------------------------------------------------------*/
/* USER CODE BEGIN PD */

/* USER CODE END PD */

/* Private macro -------------------------------------------------------------*/
/* USER CODE BEGIN PM */

/* USER CODE END PM */

/* Private variables ---------------------------------------------------------*/

/* USER CODE BEGIN PV */
extern float Ax;
extern float Ay;
extern float Az;

extern float Gx;
extern float Gy;
extern float Gz;

extern float Gx_offset;
extern float Gy_offset;
extern float Gz_offset;

float Accel_pitch = 0.0f;
float Accel_roll = 0.0f;

float Gyro_pitch = 0.0f;
float Gyro_roll = 0.0f;

// uint32_t prev_time = 0;

float alpha = 0.98f;

float Comp_pitch = 0.0f;
float Comp_roll = 0.0f;

Kalman_t pitchKalman;

float Kalman_pitch = 0.0f;

PIDcontroller pid;

// pid parameters
float kp = 40.0f;
float ki = 70.0f;
float kd = 0.5f;
float dt = 0.005f;				// 200 Hz sampling

volatile uint8_t do_control = 0;

float pid_output = 0.0f;
int dir = 0;
float duty = 0.0f;

int counter = 0;
/* USER CODE END PV */

/* Private function prototypes -----------------------------------------------*/
void SystemClock_Config(void);
/* USER CODE BEGIN PFP */

/* USER CODE END PFP */

/* Private user code ---------------------------------------------------------*/
/* USER CODE BEGIN 0 */

// timer 3 for both motors, channel 1 for motor 1, channel 2 for motor 2
void TIM3_PWM_setup() {
	/* GPIO SetUp (PA6 -> TIM3_CH1, PA7 -> TIM3_CH2) */
	RCC->AHB1ENR |= (1 << RCC_AHB1ENR_GPIOAEN_Pos);		// Enable GPIO6

	// PA6 -> CH1
	GPIOA->MODER |= (2 << 12); 							// Alternate function mode PA6
	GPIOA->AFR[0] |= (2 << 24); 						// Alternate function n2 for PA6 (TIM3 CH1)
	GPIOA->OSPEEDR 	|= (3 << 12);  						// High Speed for PIN PA6
	GPIOA->PUPDR |= (2 << 12);							// Pull Down for PA6

	// PA7 -> CH2
	GPIOA->MODER |= (2 << 14); 							// Alternate function mode PA7
	GPIOA->AFR[0] |= (2 << 28); 						// Alternate function n2 for PA7 (TIM3 CH2)
	GPIOA->OSPEEDR 	|= (3 << 14);  						// High Speed for PIN PA7
	GPIOA->PUPDR |= (2 << 14);							// Pull Down for PA7

	/* TIM3 SetUp */
	RCC->APB1ENR |= (1 << RCC_APB1ENR_TIM3EN_Pos); 		// Clock to TIM3

	/* TIM3 Base Config */
	TIM3->CR1 &= ~(1 << TIM_CR1_UDIS_Pos); 				// Update event enabled
	TIM3->CR1 &= ~(1 << TIM_CR1_URS_Pos);				// Update event generated by any source
	TIM3->CR1 &= (1 << TIM_CR1_DIR_Pos); 				// Upcounting direction
	TIM3->CR1 &= (0x03 << TIM_CR1_CMS_Pos); 			// (00) Edge aligned mode
	TIM3->CR1 |= (1 << TIM_CR1_ARPE_Pos); 				// Auto reload preload enabled

	/* Channel 1 - PA6 / CH1 Config */
	TIM3->CCMR1 &= ~(0x03 << TIM_CCMR1_CC1S_Pos); 		// TIM3_CH1 configured as output
	TIM3->CCMR1 |= (1 << TIM_CCMR1_OC1PE_Pos); 			// Preload CCR1 register as well
	TIM3->CCMR1 |= (0x6 << TIM_CCMR1_OC1M_Pos); 		// PWM Mode 1
	TIM3->CCER |= (1 << TIM_CCER_CC1E_Pos); 			// Enable output channel 1
	TIM3->CCER &= ~(1 << TIM_CCER_CC1P_Pos); 			// Active high

	/* Channel 2 - PA7 / CH2 Config */
	TIM3->CCMR1 &= ~(0x03 << TIM_CCMR1_CC2S_Pos); 		// TIM3_CH2 configured as output
	TIM3->CCMR1 |= (1 << TIM_CCMR1_OC2PE_Pos); 			// Preload CCR2 register as well
	TIM3->CCMR1 |= (0x6 << TIM_CCMR1_OC2M_Pos); 		// PWM Mode 1
	TIM3->CCER |= (1 << TIM_CCER_CC2E_Pos); 			// Enable output channel 2
	TIM3->CCER &= ~(1 << TIM_CCER_CC2P_Pos); 			// Active high

	/* Pre-scaler and auto-reload */
	TIM3->PSC = 84 - 1; 								// CNT incremented every ms
	TIM3->ARR = 200 - 1; 								// Update event every seconds

	/* Initial duty cycles */
	TIM3->CCR1 = 500 - 1;								// 50% duty cycle on channel 1
	TIM3->CCR2 = 500 - 1;								// 50% duty cycle on channel 2

	TIM3->EGR |= (1 << TIM_EGR_UG_Pos); 				// Fire an update event to update shadow registers
}

// Setup function for gpio pins to control motor direction
void Motor_GPIO_dir_setup(){
	/* PC0-PC3 for controlling direction pins */
	// PC0->IN1, PC1->IN2, PC2->IN3, PC3->IN4
	RCC->AHB1ENR |= (1 << RCC_AHB1ENR_GPIOCEN_Pos);		// enable gpioc

	/* set to general purpose output */
	GPIOC->MODER &= ~(3 << 0);							// clear PC0
	GPIOC->MODER |= (1 << 0);							// set PC0 output

	GPIOC->MODER &= ~(3 << 2);							// clear PC1
	GPIOC->MODER |= (1 << 2);							// set PC1 output

	GPIOC->MODER &= ~(3 << 4);							// clear PC2
	GPIOC->MODER |= (1 << 4);							// set PC2 output

	GPIOC->MODER &= ~(3 << 6);							// clear PC3
	GPIOC->MODER |= (1 << 6);							// set PC3 output

	/* set output type to push-pull */
	GPIOC->OTYPER &= ~(1 << 0);							// clear OT0
	GPIOC->OTYPER &= ~(1 << 1);							// clear OT1
	GPIOC->OTYPER &= ~(1 << 2);							// clear OT2
	GPIOC->OTYPER &= ~(1 << 3);							// clear OT3

	/* set output speed to high (11) */
	GPIOC->OSPEEDR |= (3 << 0);							// PC0
	GPIOC->OSPEEDR |= (3 << 2);							// PC1
	GPIOC->OSPEEDR |= (3 << 4);							// PC2
	GPIOC->OSPEEDR |= (3 << 6);							// PC3

	/* set pull-up/pull-down to no pu/pd (00) */
	GPIOC->PUPDR &= ~(3 << 0);							// clear PC0
	GPIOC->PUPDR &= ~(3 << 2);							// clear PC1
	GPIOC->PUPDR &= ~(3 << 4);							// clear PC2
	GPIOC->PUPDR &= ~(3 << 6);							// clear PC3
}

// function for setting the motor direction during runtime
// 1 =
void set_robot_dir(int dir){
	if (dir < 0){
		// robot is tilting to left, so need to counteract by driving both wheels to the left
		// Motor 1 forward, Motor 2 reverse
		// M1: IN1 = 0, IN2 = 1 -> forward
		// M2: IN3 = 1, IN4 = 0 -> reverse
		GPIOC->ODR &= ~(1 << 0);		// PC0 = 0
		GPIOC->ODR |= (1 << 1);			// PC1 = 1
		GPIOC->ODR |= (1 << 2);			// PC2 = 1
		GPIOC->ODR &= ~(1 << 3);		// PC3 = 0
	} else if (dir > 0){
		// robot is tilting to right, so need to counteract by driving both wheels to the right
		// Motor 1 reverse, Motor 2 forward
		// M1: IN1 = 1, IN2 = 0 -> reverse
		// M2: IN3 = 0, IN4 = 1 -> forward
		GPIOC->ODR |= (1 << 0);			// PC0 = 1
		GPIOC->ODR &= ~(1 << 1);		// PC1 = 0
		GPIOC->ODR &= ~(1 << 2);		// PC2 = 0
		GPIOC->ODR |= (1 << 3);			// PC3 = 1
	}
}

/* Timer 6 for creating an interrupt every 5 ms (200 Hz) for the sensor sampling and pid calculation */
void TIM6_basic_setup() {

	RCC->APB1ENR |= (1 << RCC_APB1ENR_TIM6EN_Pos); 		// Clock to TIM6

	TIM6->CR1 &= ~(1 << TIM_CR1_UDIS_Pos); 				// Update event enable
	TIM6->CR1 |= (1 << TIM_CR1_URS_Pos);				// Update event generated only by overflow/underflow
	TIM6->CR1 |= (1 << TIM_CR1_ARPE_Pos); 				// Auto reload preload enabled

	TIM6->PSC = 84 - 1; 						    	// CLock divided by 84 - 1 microsecond per tick
	TIM6->ARR = 5000 - 1; 								// Update event every 5 ms (200 Hz)

	TIM6->DIER |= (1 << TIM_DIER_UIE_Pos); 				// Trigger an interrupt every update event

	TIM3->EGR |= (1 << TIM_EGR_UG_Pos); 				// Fire an update event to update shadow registers

	NVIC_EnableIRQ(TIM6_DAC_IRQn);						// Enable interrupt for TIM6
	NVIC_SetPriority(TIM6_DAC_IRQn, 0); 				// Set Priority
}

/* Interrupt every 5 ms to do the measurement and pid calculation */
void TIM6_DAC_IRQHandler() {
	if((TIM6->SR >> TIM_SR_UIF_Pos) & 0x01) {
		//NVIC_ClearPendingIRQ(TIM6_DAC_IRQn);
		TIM6->SR &= ~(1 << TIM_SR_UIF_Pos); 		// clear interrupt flag
		do_control = 1;
	}
}
/* USER CODE END 0 */

/**
  * @brief  The application entry point.
  * @retval int
  */
int main(void)
{

  /* USER CODE BEGIN 1 */

  /* USER CODE END 1 */

  /* MCU Configuration--------------------------------------------------------*/

  /* Reset of all peripherals, Initializes the Flash interface and the Systick. */
  HAL_Init();

  /* USER CODE BEGIN Init */

  /* USER CODE END Init */

  /* Configure the system clock */
  SystemClock_Config();

  /* USER CODE BEGIN SysInit */

  /* USER CODE END SysInit */

  /* Initialize all configured peripherals */
  MX_GPIO_Init();
  MX_USART2_UART_Init();
  /* USER CODE BEGIN 2 */
  // Reset I2C1 peripheral
//  RCC->APB1RSTR |=  (1 << 21);   // Set I2C1RST bit
//  for (volatile int i = 0; i < 100; i++); // short delay (not always needed)
//  RCC->APB1RSTR &= ~(1 << 21);   // Clear I2C1RST bit

  MPU6050_Init();
  Kalman_Init(&pitchKalman);
  PID_Init(&pid, kp, ki, kd, dt);
  TIM3_PWM_setup();
  Motor_GPIO_dir_setup();
  TIM6_basic_setup();

  MPU6050_Calc_Offset();

  //prev_time = HAL_GetTick();

  /* USER CODE END 2 */

  /* Infinite loop */
  /* USER CODE BEGIN WHILE */
  TIM6->CR1 |= (1 << TIM_CR1_CEN_Pos);		// enable timer6 for sampling interrupt
  TIM3->CR1 |= (1 << TIM_CR1_CEN_Pos);		// enable timer3 for pwm
  while (1)
  {
    /* USER CODE END WHILE */

    /* USER CODE BEGIN 3 */
	  if (do_control){
		  do_control = 0;

		  MPU6050_Read_Accel();
		  Accel_pitch = atan2f(Ax, sqrtf(Ay*Ay + Az*Az)) * 180.0f / M_PI;
		  Accel_roll = atan2f(Ay, sqrtf(Ax*Ax + Az*Az)) * 180.0f / M_PI;

		  MPU6050_Read_Gyro();
		  Gx = Gx - Gx_offset;
		  Gy = Gy - Gy_offset;
		  Gyro_pitch = Gyro_pitch + Gy * dt;
		  Gyro_roll = Gyro_roll + Gx * dt;

		  Comp_pitch = alpha * Gyro_pitch + (1 - alpha) * Accel_pitch;
		  Comp_roll = alpha * Gyro_roll + (1 - alpha) * Accel_roll;

		  Kalman_pitch = Kalman_GetAngle(&pitchKalman, Accel_pitch, Gy, dt);
//		  Kalman_pitch = 0.0f;

		  pid_output = PID_Compute(&pid, 0.0f, Kalman_pitch);

		  if (pid_output > 0) dir = 1;
		  if (pid_output < 0) dir = -1;

		  set_robot_dir(dir);

		  duty = fabsf(pid_output);
		  if (duty > 1000.0f) duty = 1000.0f;
		  if (duty < 150.0f) duty = 0.0f;

		  TIM3->CCR1 = duty;
		  TIM3->CCR2 = duty;

		  counter += 1;
	  }

//	  char buffer[100];
//	  //snprintf(buffer, sizeof(buffer), "%.2f,%.2f,%.2f\r\n", Accel_pitch, Gyro_pitch, Kalman_pitch);
//	  printf("accel: %.2f\tgyro: %.2f\tkalman: %.2f\r\n", Accel_pitch, Gyro_pitch, Kalman_pitch);
//	  printf("Angle: %.2f\n", Kalman_pitch);
//	  HAL_UART_Transmit(&huart2, (uint8_t*)buffer, strlen(buffer), HAL_MAX_DELAY);


//	  HAL_Delay(5);
  }
  /* USER CODE END 3 */
}

/**
  * @brief System Clock Configuration
  * @retval None
  */
void SystemClock_Config(void)
{
  RCC_OscInitTypeDef RCC_OscInitStruct = {0};
  RCC_ClkInitTypeDef RCC_ClkInitStruct = {0};

  /** Configure the main internal regulator output voltage
  */
  __HAL_RCC_PWR_CLK_ENABLE();
  __HAL_PWR_VOLTAGESCALING_CONFIG(PWR_REGULATOR_VOLTAGE_SCALE3);

  /** Initializes the RCC Oscillators according to the specified parameters
  * in the RCC_OscInitTypeDef structure.
  */
  RCC_OscInitStruct.OscillatorType = RCC_OSCILLATORTYPE_HSI;
  RCC_OscInitStruct.HSIState = RCC_HSI_ON;
  RCC_OscInitStruct.HSICalibrationValue = RCC_HSICALIBRATION_DEFAULT;
  RCC_OscInitStruct.PLL.PLLState = RCC_PLL_ON;
  RCC_OscInitStruct.PLL.PLLSource = RCC_PLLSOURCE_HSI;
  RCC_OscInitStruct.PLL.PLLM = 16;
  RCC_OscInitStruct.PLL.PLLN = 336;
  RCC_OscInitStruct.PLL.PLLP = RCC_PLLP_DIV4;
  RCC_OscInitStruct.PLL.PLLQ = 2;
  RCC_OscInitStruct.PLL.PLLR = 2;
  if (HAL_RCC_OscConfig(&RCC_OscInitStruct) != HAL_OK)
  {
    Error_Handler();
  }

  /** Initializes the CPU, AHB and APB buses clocks
  */
  RCC_ClkInitStruct.ClockType = RCC_CLOCKTYPE_HCLK|RCC_CLOCKTYPE_SYSCLK
                              |RCC_CLOCKTYPE_PCLK1|RCC_CLOCKTYPE_PCLK2;
  RCC_ClkInitStruct.SYSCLKSource = RCC_SYSCLKSOURCE_PLLCLK;
  RCC_ClkInitStruct.AHBCLKDivider = RCC_SYSCLK_DIV1;
  RCC_ClkInitStruct.APB1CLKDivider = RCC_HCLK_DIV2;
  RCC_ClkInitStruct.APB2CLKDivider = RCC_HCLK_DIV1;

  if (HAL_RCC_ClockConfig(&RCC_ClkInitStruct, FLASH_LATENCY_2) != HAL_OK)
  {
    Error_Handler();
  }
}

/* USER CODE BEGIN 4 */

/* USER CODE END 4 */

/**
  * @brief  This function is executed in case of error occurrence.
  * @retval None
  */
void Error_Handler(void)
{
  /* USER CODE BEGIN Error_Handler_Debug */
  /* User can add his own implementation to report the HAL error return state */
  __disable_irq();
  while (1)
  {
  }
  /* USER CODE END Error_Handler_Debug */
}

#ifdef  USE_FULL_ASSERT
/**
  * @brief  Reports the name of the source file and the source line number
  *         where the assert_param error has occurred.
  * @param  file: pointer to the source file name
  * @param  line: assert_param error line source number
  * @retval None
  */
void assert_failed(uint8_t *file, uint32_t line)
{
  /* USER CODE BEGIN 6 */
  /* User can add his own implementation to report the file name and line number,
     ex: printf("Wrong parameters value: file %s on line %d\r\n", file, line) */
  /* USER CODE END 6 */
}
#endif /* USE_FULL_ASSERT */
